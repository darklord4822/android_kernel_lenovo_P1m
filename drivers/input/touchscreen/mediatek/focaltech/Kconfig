## drivers/input/touchscreen/mediatek/focaltech/Kconfig
```kconfig
if TOUCHSCREEN_MTK_FOCALTECH 

config FOCALTECH_POWER_BY_PMIC
        bool "ft5436 power by pmic &  regulator"
        default n
        help
          selected if power by pmic

          Select here if tp power by pmic
endif
```

## drivers/misc/mediatek/accelerometer/KXTJ2_1009-new/Kconfig
```kconfig
config MTK_KXTJ2_1009_NEW
	bool "MTK_KXTJ2_1009_NEW for MediaTek package"
	default n
	help
	  It support different accelerometer sensor.
          If this option is set,
	  it will support
          CONFIG_MTK_KXTJ2_1009_NEW Accelerometer.
```
